## conf/layer.conf
```bitbake
# We have a conf and classes directory, add to BBPATH
BBPATH .= ":${LAYERDIR}"

# We have a recipes-* directories, add to BBFILES
BBFILES += " \
	${LAYERDIR}/recipes-*/*/*.bb \
	${LAYERDIR}/recipes-*/*/*.bbappend \
"

BBFILE_COLLECTIONS += "jetson-tx1"
BBFILE_PATTERN_jetson-tx1 = "^${LAYERDIR}/"
BBFILE_PRIORITY_jetson-tx1 = "6"
```
